VERSION ""

NS_ :

BS_:

BU_: GWM IPC BMC
VAL_TABLE_ Switch_Position 1 "ON" 0 "OFF" ;

BO_ 257 GWMMessage: 1 Vector__XXX
 SG_ GWM_Signal : 0|2@1+ (1,0) [0|0] "" Vector__XXX

BO_ 256 BCMMessage: 1 Vector__XXX
 SG_ BCM_Signal : 0|2@1+ (1,0) [0|3] "" Vector__XXX

EV_ Env_IPC: 0 [0|1] "" 0 1 DUMMY_NODE_VECTOR0 Vector__XXX;

EV_ Env_GWM: 0 [0|1] "" 0 2 DUMMY_NODE_VECTOR0 Vector__XXX;

EV_ Env_BCM: 0 [0|1] "" 0 3 DUMMY_NODE_VECTOR0 Vector__XXX;

VAL_ 257 GWM_Signal 1 "ON" 0 "OFF" ;
VAL_ 256 BCM_Signal 1 "ON" 0 "OFF" ;
VAL_ Env_IPC 1 "ON" 0 "OFF" ;
VAL_ Env_BCM 1 "ON" 0 "OFF" ;
